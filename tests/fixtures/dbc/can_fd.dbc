VERSION "1.0"

NS_ :

BS_:

BU_: Gateway

BA_DEF_ BO_ "VFrameFormat" ENUM "StandardCAN","ExtendedCAN","reserved","J1939PG","StandardCAN_FD","ExtendedCAN_FD";

BO_ 1536 FdFramePayload: 64 Gateway
 SG_ BlobFirst : 0|32@1+ (1,0) [0|4294967295] "" Gateway
 SG_ BlobSecond : 32|32@1+ (1,0) [0|4294967295] "" Gateway
BA_ "VFrameFormat" BO_ 1536 4;
