VERSION "1.0"

NS_ :

BS_:

BU_: Sensor

BO_ 291 FloatFrame: 8 Sensor
 SG_ EngineSpeed : 0|16@1+ (0.25,0) [0|16383.75] "rpm" Sensor
 SG_ ManifoldPressure : 16|32@1+ (1,0) [0|0] "" Sensor

SIG_VALTYPE_ 291 ManifoldPressure : 1;
