VERSION "1.0"

NS_ :

BS_:

BU_: Mux

BO_ 1024 MuxFrame: 8 Mux
 SG_ ModeSwitch M : 0|8@1+ (1,0) [0|2] "" Mux
 SG_ ModeASignal m0 : 8|16@1+ (0.1,0) [0|6553.5] "V" Mux
 SG_ ModeBSignal m1 : 8|16@1+ (1,0) [0|65535] "count" Mux
 SG_ ModeCSignal m2 : 8|8@1+ (1,0) [0|255] "" Mux

VAL_ 1024 ModeSwitch 0 "ModeA" 1 "ModeB" 2 "ModeC" ;
