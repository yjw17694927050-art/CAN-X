VERSION "1.0"

NS_ :

BS_:

BU_: Body

BO_ 768 DoorStatus: 4 Body
 SG_ DoorState : 0|8@1+ (1,0) [0|3] "" Body
 SG_ LockState : 8|4@1+ (1,0) [0|2] "" Body

VAL_ 768 DoorState 0 "Closed" 1 "Open" 2 "Error" ;
VAL_ 768 LockState 0 "Unlocked" 1 "Locked" ;
