VERSION "1.0"

NS_ :

BS_:

BU_: Gateway J1939Node

BO_ 2147483939 TruckStatus: 8 Gateway
 SG_ VehicleSpeed : 0|16@1+ (0.00390625,0) [0|250] "km/h" J1939Node
 SG_ GearPosition : 16|8@1+ (1,0) [0|15] "" J1939Node
