VERSION "1.0"

NS_ :

BS_:

BU_: Gateway

BA_DEF_ BO_ "VFrameFormat" ENUM "StandardCAN","ExtendedCAN","reserved","J1939PG","StandardCAN_FD","ExtendedCAN_FD";

BO_ 1536 FdShortFrame: 12 Gateway
 SG_ Counter : 0|8@1+ (1,0) [0|255] "" Gateway
 SG_ Value : 8|16@1+ (1,0) [0|65535] "" Gateway

BA_ "VFrameFormat" BO_ 1536 4;
